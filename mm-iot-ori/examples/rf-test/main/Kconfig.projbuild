## mm-iot-ori/examples/rf-test/main/Kconfig.projbuild
```kconfig
menu "RF Test App Configuration"

    orsource "$IDF_PATH/examples/common_components/env_caps/$IDF_TARGET/Kconfig.env_caps"

    config RF_TEST_UART_PORT_NUM
        int "UART port number"
        range 0 2 if IDF_TARGET_ESP32 || IDF_TARGET_ESP32S3
        default 0 if IDF_TARGET_ESP32 || IDF_TARGET_ESP32S3
        range 0 1
        default 0
        help
            UART communication port number for the example.
            See UART documentation for available port numbers.

    config RF_TEST_UART_BAUD_RATE
        int "UART communication speed"
        range 1200 115200
        default 115200
        help
            UART communication speed for Modbus example.

    config RF_TEST_UART_RXD
        int "UART RXD pin number"
        range ENV_GPIO_RANGE_MIN ENV_GPIO_IN_RANGE_MAX
        default 44
        help
            GPIO number for UART RX pin. See UART documentation for more information
            about available pin numbers for UART.

    config RF_TEST_UART_TXD
        int "UART TXD pin number"
        range ENV_GPIO_RANGE_MIN ENV_GPIO_OUT_RANGE_MAX
        default 43
        help
            GPIO number for UART TX pin. See UART documentation for more information
            about available pin numbers for UART.

endmenu
```

## mm-iot-ori/framework/src/mmiperf/Kconfig
```kconfig
# Copyright 2024 Morse Micro
# SPDX-License-Identifier: Apache-2.0
menu "Morse Micro Iperf Configuration"
    config MMIPERF_STACK_SIZE
        int "Stack size in words"
        default 640
        help
            Stack size in words to use for MMIPERF tasks

endmenu
```
